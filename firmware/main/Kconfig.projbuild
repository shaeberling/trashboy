## firmware/main/Kconfig.projbuild
```kconfig
menu "Trashboy"

choice TRASHBOY_BOARD
    prompt "Board"
    default TRASHBOY_BOARD_WAVESHARE_28B
    help
      The hardware this firmware is built for. Each board has its own
      sources in main/ (see main/CMakeLists.txt); the emulator core is
      shared.

config TRASHBOY_BOARD_WAVESHARE_28B
    bool "Waveshare ESP32-S3-Touch-LCD-2.8B + TrashBoy carrier"

config TRASHBOY_BOARD_SENSECAP_WATCHER
    bool "Seeed SenseCAP Watcher (experimental)"
    help
      Round 412x412 display, a wheel with a push button, no menus: boots
      straight into Breakdown. Build it in its own directory with
      scripts/watcher.sh, which adds sdkconfig.defaults.watcher (32 MB
      flash, a partition table that leaves Seeed's factory data alone).

endchoice

config TRASHBOY_BT_AUTO_PAIR
    bool "Pair the first Bluetooth keyboard found, automatically"
    default n
    help
      Normally a Bluetooth keyboard is only paired from Settings ->
      Bluetooth Keyboard, where the user picks it from a list. With this
      enabled, whenever no keyboard is paired the board keeps scanning in
      the background and pairs with the first keyboard it finds in pairing
      mode (the strongest signal if there are several), with no input
      needed.

      For a board that has no way to drive the menus (no buttons, no
      touch). Note that after "Unpair" in Settings the board will grab the
      next keyboard in pairing mode again.

config TRASHBOY_ENABLE_MINI_TRS_MODE
    bool "Mini TRS mode: a plain TRS-80 with TRS-IO, driven by a BT keyboard"
    default n
    select TRASHBOY_BT_AUTO_PAIR
    help
      Turns the board into a small TRS-80 Model III with TRS-IO, for a
      board without buttons or touch:

      - Wi-Fi is run by TRS-IO (the trs-io submodule) instead of TrashBoy's
        own Wi-Fi manager. TRS-IO connects with its own stored credentials
        and runs its web server (http://trs-io.local or the IP shown in the
        status bar): settings for Wi-Fi, SMB share and time zone, virtual
        printer, status, log. It also syncs the time and mounts the SMB
        share if one is set. With no Wi-Fi configured it opens an open
        access point named "TRS-IO"; join it and open http://192.168.4.1.
        Saving Wi-Fi settings there reboots the device. TrashBoy's preset
        credentials and Settings -> Wi-Fi Setup are not used.
      - A Bluetooth keyboard is paired automatically (selects
        TRASHBOY_BT_AUTO_PAIR), and as soon as one is connected the board
        boots the TRS-80 ROM, with no game loaded, instead of showing the
        main menu. Page Up leaves the TRS-80 for the menu as usual.

config TRASHBOY_DISPLAY_ROTATE_180
    bool "Turn the picture 180 degrees"
    default n
    help
      For a board mounted the other way up in its case: the menus and the
      TRS-80 screen are drawn upside down relative to the default. Touch
      input follows (LVGL applies the rotation), but the on-screen
      keyboard is still laid out for the default orientation: meant for
      boards without touch, such as Mini TRS mode's.

config TRASHBOY_WIFI_USE_PRESET
    bool "Use preset Wi-Fi credentials instead of the interactive dialog"
    default n
    help
      When enabled, the Wi-Fi setup step at boot tries to connect to the
      SSID/password configured below before showing the on-device network
      picker. If the preset fails to connect, the normal interactive
      scan/pick/password dialog is used as a fallback.

      Intended for developer iteration so a board can boot straight onto
      a known test network without keyboard interaction. Credentials are
      compiled into the firmware image -- do not enable for shipped builds.

config TRASHBOY_WIFI_PRESET_SSID
    string "Preset Wi-Fi SSID"
    depends on TRASHBOY_WIFI_USE_PRESET
    default ""

config TRASHBOY_WIFI_PRESET_PASSWORD
    string "Preset Wi-Fi password"
    depends on TRASHBOY_WIFI_USE_PRESET
    default ""

config TRASHBOY_SOUND_DIAG
    bool "Enable SDM audio diagnostics (test tone + telemetry)"
    default n
    help
      When enabled, the sound subsystem logs SDM activity once per second
      (timer callback rate, count of non-zero density writes, ring fill,
      and the enable/tx gate states) and plays a continuous 440 Hz test
      tone. This lets you verify the SDM -> RC filter -> PAM8302 ->
      speaker chain independently of the emulator when bringing up or
      debugging audio hardware.

      Leave disabled for normal use: the test tone would otherwise play
      over (and starve) real game audio, plus the per-second log is noise.

config TRASHBOY_PERF_DIAG
    bool "Enable emulator speed telemetry (per-second perf log)"
    default n
    help
      When enabled, two "perf" log lines are printed once per second while
      a game is running:

        z80:  emulated speed as a percentage of real hardware, and how
              much of the time the Z80 task spent idle in its pacing
              delay. speed < 100% with idle near 0% means the emulator
              itself cannot keep up.
        disp: how many screen updates were pushed, their average / worst
              cost in milliseconds, and the share of the display task's
              time they took.

      Use it to tell an emulation bottleneck from a display one before
      optimizing either. Leave disabled for normal use.

config TRASHBOY_BATTERY_DIVIDER_X1000
    int "Battery voltage divider factor (x1000)"
    default 3000
    range 1000 10000
    help
      Battery voltage = voltage at GPIO 4 * this / 1000. The Waveshare
      ESP32-S3-Touch-LCD-2.8B divides the battery by 3 onto GPIO 4 (which
      is also the SDM audio pin). Calibrate against a multimeter: read the
      "battery" log line from Settings -> Battery, then set this to
      3000 * meter_mV / reported_mV.

endmenu
```
